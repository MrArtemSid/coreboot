## src/mainboard/machinist/Kconfig
```kconfig
## SPDX-License-Identifier: GPL-2.0-only

if VENDOR_MACHINIST

choice
	prompt "Mainboard model"

source "src/mainboard/machinist/*/Kconfig.name"

endchoice

source "src/mainboard/machinist/*/Kconfig"

config MAINBOARD_VENDOR
	default "Machinist"

endif # VENDOR_MACHINIST
```

## src/mainboard/machinist/x99-b9/Kconfig
```kconfig
## SPDX-License-Identifier: GPL-2.0-only

if BOARD_MACHINIST_X99_B9

config BOARD_SPECIFIC_OPTIONS
	def_bool y
	select NORTHBRIDGE_INTEL_GRANTLEY
	select SOUTHBRIDGE_INTEL_LYNXPOINT
	select SERIRQ_CONTINUOUS_MODE
	select BOARD_ROMSIZE_KB_16384
	select AZALIA_USE_LEGACY_VERB_TABLE
	select HAVE_ACPI_TABLES

config MAINBOARD_DIR
	default "machinist/x99-b9"

config MAINBOARD_PART_NUMBER
	default "X99 B9"

config BOOTBLOCK_CONSOLE
	default y

endif # BOARD_MACHINIST_X99_B9
```

## src/mainboard/machinist/x99-b9/Kconfig.name
```kconfig
## SPDX-License-Identifier: GPL-2.0-only

config BOARD_MACHINIST_X99_B9
	bool "X99 B9"
```

## src/mainboard/qcom/Kconfig
```kconfig
## SPDX-License-Identifier: GPL-2.0-only

if VENDOR_QCOM

choice
	prompt "Mainboard model"

source "src/mainboard/qcom/*/Kconfig.name"

endchoice

source "src/mainboard/qcom/*/Kconfig"

config MAINBOARD_VENDOR
	default "Qualcomm"

endif # VENDOR_QCOM
```

## src/mainboard/qcom/msm89x7/Kconfig.name
```kconfig
## SPDX-License-Identifier: GPL-2.0-only

comment "MSM89x7 devices booting coreboot from the stock Android bootloader"

config BOARD_QCOM_MSM89X7_GENERIC
	bool "->  Generic MSM8917/MSM8937/MSM8940 device"

config BOARD_QCOM_MSM89X7_SANTONI
	bool "->  Xiaomi Redmi 4X (santoni)"
```

## src/mainboard/syntacore/Kconfig
```kconfig
# SPDX-License-Identifier: GPL-2.0-only

if VENDOR_SYNTACORE

choice
	prompt "Mainboard model"
source "src/mainboard/syntacore/*/Kconfig.name"
endchoice

source "src/mainboard/syntacore/*/Kconfig"

config MAINBOARD_VENDOR
	default "Syntacore"

endif
```

## src/mainboard/syntacore/Kconfig.name
```kconfig
## SPDX-License-Identifier: GPL-2.0-only

config VENDOR_SYNTACORE
	bool "Syntacore"
```

## src/mainboard/syntacore/scr_cluster/Kconfig
```kconfig
# SPDX-License-Identifier: GPL-2.0-only

if BOARD_SYNTACORE_SCR_CLUSTER

config BOARD_SPECIFIC_OPTIONS
	def_bool y
	select SOC_SYNTACORE_SCR
	select BOARD_ROMSIZE_KB_16384

config MAINBOARD_DIR
	default "syntacore/scr_cluster"

config MAINBOARD_PART_NUMBER
	default "SCR cluster"

config RISCV_DTS_FILE
	string "Devicetree source file"
	default "src/mainboard/syntacore/scr_cluster/dts/scr_cluster.dts"
	help
	  Path to the .dts file, relative to the coreboot tree or absolute.
	  The default selects the SCR9/SCR7, L3/L2, QEMU and IPI parts from
	  the options above. A custom file is passed through the same
	  preprocessor with the board dts/ and Linux Syntacore directories on
	  the include path, so it can extend the default with
	  #include "scr_cluster.dts" or include the Linux .dtsi files.

config SCR_CLUSTER_QEMU
	bool "Target the SC-DT QEMU machine"
	default n

endif
```

## src/mainboard/syntacore/scr_cluster/Kconfig.name
```kconfig
# SPDX-License-Identifier: GPL-2.0-only

config BOARD_SYNTACORE_SCR_CLUSTER
	bool "SCR cluster (VCU118 FPGA / SC-DT QEMU)"
```

## src/mainboard/syntacore/scr_l2_cluster/Kconfig
```kconfig
## SPDX-License-Identifier: GPL-2.0-only

if BOARD_SYNTACORE_SCR9_L2

config BOARD_SYNTACORE_SCR_L2_CLUSTER
	def_bool y
	select SOC_SYNTACORE_SCR9_L2

endif # BOARD_SYNTACORE_SCR9_L2

if BOARD_SYNTACORE_SCR7_L2

config BOARD_SYNTACORE_SCR_L2_CLUSTER
	def_bool y
	select SOC_SYNTACORE_SCR7_L2

endif # BOARD_SYNTACORE_SCR7_L2

if BOARD_SYNTACORE_SCR5_RV64

config BOARD_SYNTACORE_SCR_L2_CLUSTER
	def_bool y
	select SOC_SYNTACORE_SCR5_RV64

endif # BOARD_SYNTACORE_SCR5_RV64

if BOARD_SYNTACORE_SCR_L2_CLUSTER

config BOARD_SPECIFIC_OPTIONS
	def_bool y
	select BOARD_ROMSIZE_KB_16384

config MAINBOARD_DIR
	default "syntacore/scr_l2_cluster"

config MAINBOARD_PART_NUMBER
	default "SCR9 L2 cluster" if BOARD_SYNTACORE_SCR9_L2
	default "SCR7 L2 cluster" if BOARD_SYNTACORE_SCR7_L2
	default "SCR5 RV64 L2 cluster" if BOARD_SYNTACORE_SCR5_RV64

config RISCV_ARCH
	string
	default "rv64imafd"

config RISCV_ABI
	string
	default "lp64d"

config RISCV_CODEMODEL
	string
	default "medany"

config SCR9_L2_QEMU_VIRTIO
	bool "Describe the SC-DT QEMU virtio-mmio transports in the SCR9 L2 device tree"
	depends on BOARD_SYNTACORE_SCR9_L2
	default n
	help
	  The SC-DT QEMU scr9_l2 machine attaches eight virtio-mmio transports
	  at 0x00ffffff_ff100000..0x00ffffff_ff107000 that the real VCU118
	  prototype lacks. Enable to build the board device tree from
	  vcu118_scr9_l2_qemu.dts, which adds the transport nodes plus an
	  opensbi-domains region so the trusted-domain payload can reach them.

config RISCV_DTS_FILE
	string
	default "src/mainboard/syntacore/scr_l2_cluster/vcu118_scr9_l2_qemu.dts" if SCR9_L2_QEMU_VIRTIO
	default "src/mainboard/syntacore/scr_l2_cluster/scr9_l2.dts" if BOARD_SYNTACORE_SCR9_L2
	default "3rdparty/linux/arch/riscv/boot/dts/syntacore/vcu118_scr7_l2.dts" if BOARD_SYNTACORE_SCR7_L2
	default "3rdparty/linux/arch/riscv/boot/dts/syntacore/vcu118_scr5_rv64_l2.dts" if BOARD_SYNTACORE_SCR5_RV64

endif # BOARD_SYNTACORE_SCR_L2_CLUSTER
```

## src/mainboard/syntacore/scr_l2_cluster_32/Kconfig
```kconfig
## SPDX-License-Identifier: GPL-2.0-only

if BOARD_SYNTACORE_SCR5_RV32

config BOARD_SPECIFIC_OPTIONS
	def_bool y
	select SOC_SYNTACORE_SCR5_RV32
	select BOARD_ROMSIZE_KB_16384

config MAINBOARD_DIR
	default "syntacore/scr_l2_cluster_32"

config MAINBOARD_PART_NUMBER
	default "SCR5 RV32 L2 cluster"

config RISCV_ARCH
	string
	default "rv32imafd"

config RISCV_ABI
	string
	default "ilp32d"

config RISCV_CODEMODEL
	string
	default "medany"

config RISCV_DTS_FILE
	string
	default "3rdparty/linux/arch/riscv/boot/dts/syntacore/vcu118_scr5_rv32_l2.dts"

endif # BOARD_SYNTACORE_SCR5_RV32
```

## src/mainboard/syntacore/scr_l3_cluster/Kconfig
```kconfig
## SPDX-License-Identifier: GPL-2.0-only

if BOARD_SYNTACORE_SCR9_L3

config BOARD_SYNTACORE_SCR_L3_CLUSTER
	def_bool y
	select SOC_SYNTACORE_SCR9_L3

endif # BOARD_SYNTACORE_SCR9_L3

if BOARD_SYNTACORE_SCR7_L3

config BOARD_SYNTACORE_SCR_L3_CLUSTER
	def_bool y
	select SOC_SYNTACORE_SCR7_L3

endif # BOARD_SYNTACORE_SCR7_L3

if BOARD_SYNTACORE_SCR_L3_CLUSTER

config BOARD_SPECIFIC_OPTIONS
	def_bool y
	select BOARD_ROMSIZE_KB_16384

config MAINBOARD_DIR
	default "syntacore/scr_l3_cluster"

config MAINBOARD_PART_NUMBER
	default "SCR9 L3 cluster" if BOARD_SYNTACORE_SCR9_L3
	default "SCR7 L3 cluster" if BOARD_SYNTACORE_SCR7_L3

config RISCV_ARCH
	string
	default "rv64imafd"

config RISCV_ABI
	string
	default "lp64d"

config RISCV_CODEMODEL
	string
	default "medany"

config SCR9_L3_QEMU_VIRTIO
	bool "Describe the SC-DT QEMU virtio-mmio transports in the SCR9 L3 device tree"
	depends on BOARD_SYNTACORE_SCR9_L3
	default n
	help
	  The SC-DT QEMU scr9_l3 machine attaches eight virtio-mmio transports
	  at 0xff020000..0xff027000 that the real VCU118 prototype lacks. Enable
	  to build the board device tree from vcu118_scr9_l3_qemu.dts, which
	  adds the transport nodes plus an opensbi-domains region so the
	  trusted-domain payload can reach them.

config RISCV_DTS_FILE
	string
	default "src/mainboard/syntacore/scr_l3_cluster/vcu118_scr9_l3_qemu.dts" if SCR9_L3_QEMU_VIRTIO
	default "3rdparty/linux/arch/riscv/boot/dts/syntacore/vcu118_scr9_l3.dts" if BOARD_SYNTACORE_SCR9_L3
	default "src/mainboard/syntacore/scr_l3_cluster/scr7_l3.dts" if BOARD_SYNTACORE_SCR7_L3

endif # BOARD_SYNTACORE_SCR_L3_CLUSTER
```

## src/northbridge/intel/grantley/Kconfig
```kconfig
## SPDX-License-Identifier: GPL-2.0-only

config NORTHBRIDGE_INTEL_GRANTLEY
	bool
	select CPU_INTEL_GRANTLEY
	select SEPARATE_ROMSTAGE
	select ACPI_S1_NOT_SUPPORTED
	select DRAM_SUPPORT_DDR4
	select UDK_2017_BINDING
	select DRIVERS_EFI_VARIABLE_STORE
	select DRIVERS_INTEL_OC_MAILBOX
	select CACHE_MRC_SETTINGS

if NORTHBRIDGE_INTEL_GRANTLEY

# Two slots of the module's 136 KiB training export plus the slot metadata.
config MRC_SETTINGS_CACHE_SIZE
	hex
	default 0x50000

config ECAM_MMCONF_BASE_ADDRESS
	default 0x80000000

config ECAM_MMCONF_BUS_NUMBER
	default 256

config DCACHE_RAM_BASE
	hex
	default 0xfe100000

config DCACHE_RAM_SIZE
	hex
	default 0x100000

config HAVE_INTEL_UNCORE_BIN
	bool "Add Intel Grantley Uncore binary (UncoreInitPeim)"
	default n
	help
	  Select this option to add the Intel Grantley Uncore binary
	  (UncoreInitPeim) to CBFS for DDR4 memory and uncore initialization.

config INTEL_UNCORE_BIN_FILE
	string "Intel Grantley Uncore binary path and filename"
	depends on HAVE_INTEL_UNCORE_BIN
	default "3rdparty/blobs/mainboard/\$(MAINBOARDDIR)/uncore.bin"
	help
	  The path and filename of the UncoreInitPeim binary to add to CBFS.

config GRANTLEY_INTELSETUP_FILE
	string "IntelSetup default variable path and filename"
	depends on HAVE_INTEL_UNCORE_BIN
	default "3rdparty/blobs/mainboard/\$(MAINBOARDDIR)/intelsetup.bin"
	help
	  Raw IntelSetup payload, the setup structure served to
	  UncoreInitPeim. When the file does not exist, the variable is not
	  provided and the module uses its built-in defaults.

config GRANTLEY_UNCORE_RC_SERIAL
	bool "Enable UncoreInitPeim serial debug output"
	depends on HAVE_INTEL_UNCORE_BIN
	default y
	help
	  Set serialDebugMsgLvl in the IntelSetup payload to 1 so the
	  UncoreInitPeim prints its own messages on COM1. Has no
	  effect when the board does not set
	  GRANTLEY_INTELSETUP_SERIAL_LEVEL_OFFSET.

config GRANTLEY_INTELSETUP_SERIAL_LEVEL_OFFSET
	hex
	depends on HAVE_INTEL_UNCORE_BIN
	default 0x0
	help
	  Offset of serialDebugMsgLvl in the board's IntelSetup payload,
	  or 0 when it is not known.

config GRANTLEY_INTELSETUP_FAST_BOOT_COLD_OFFSET
	hex
	depends on HAVE_INTEL_UNCORE_BIN && CACHE_MRC_SETTINGS
	default 0x1209
	help
	  Offset of attemptFastBootCold in the board's IntelSetup payload, or 0
	  to leave the byte alone. The field moves with the payload layout, so a
	  board whose payload is not the 6090-byte one must set this to 0 until
	  the offset is read from its own setup forms: writing a policy byte at
	  the wrong offset is silent and changes memory init behaviour.

config GRANTLEY_PLATFORM_TYPE
	hex
	depends on HAVE_INTEL_UNCORE_BIN
	default 0x0
	help
	  EFI_PLATFORM_TYPE the memory initializer is told it runs on, stored as
	  BoardId in the PlatformInfo HOB. It selects the QPI EPARAM tables and,
	  for the HEDT values 0x13-0x15, clears the ECC policy outright, so a
	  server board must not inherit a HEDT type. The 2-socket CRB reference
	  value is 0x00; 0x13 is the single-socket HEDT type.

config GRANTLEY_UNCORE_TRACE
	bool "Log the PEI services the memory initializer calls"
	depends on HAVE_INTEL_UNCORE_BIN
	default n
	help
	  Print every call the opaque memory initializer makes into the PEI
	  services table, with the address it called from. A release build of
	  the module carries no output of its own, so without this a stall
	  inside it cannot be told apart from slow DRAM training. Each slot has
	  its own message budget; exceeding it only stops that slot's messages.

config GRANTLEY_ME_UMA
	bool "Hand the ME UMA over to the ME during memory init"
	depends on HAVE_INTEL_UNCORE_BIN && SOUTHBRIDGE_INTEL_LYNXPOINT
	help
	  Provide the ME UMA interface to UncoreInitPeim, so the memory
	  initializer reserves the UMA the ME asks for, programs the IIO
	  ME range and sends DRAM Init Done to the ME.

	  Without it the interface reports no ME UMA and skips the handoff,
	  leaving the ME in the state it reached on its own.
	  This is experimental: leave it disabled unless the ME region on
	  the board is known to come up in normal operation.

config DCACHE_BSP_STACK_SIZE
	hex
	default 0x10000
	help
	  Stack for coreboot's own romstage code; the vendor PEIM runs on
	  the descending stack the romstage reserves for it.

config FIXED_MCHBAR_MMIO_BASE
	default 0xfed10000

config FIXED_DMIBAR_MMIO_BASE
	default 0xfed18000

config FIXED_EPBAR_MMIO_BASE
	default 0xfed19000

endif
```

## src/northbridge/intel/haswell_ep/Kconfig
```kconfig
## SPDX-License-Identifier: GPL-2.0-only

config NORTHBRIDGE_INTEL_HASWELL_EP
	bool
	select CPU_INTEL_HASWELL_EP
	select SEPARATE_ROMSTAGE
	select NO_ECAM_MMCONF_SUPPORT
	select DRAM_SUPPORT_DDR4

if NORTHBRIDGE_INTEL_HASWELL_EP

config DCACHE_RAM_BASE
	hex
	default 0xfe100000

config DCACHE_RAM_SIZE
	hex
	default 0x100000

config DCACHE_BSP_STACK_SIZE
	hex
	default 0x10000
	help
	  Stack for coreboot diagnostics only, not for the stock Uncore PEIM.

endif
```

## src/soc/syntacore/scr/Kconfig
```kconfig
# SPDX-License-Identifier: GPL-2.0-only

config SOC_SYNTACORE_SCR
	bool
	select SOC_SYNTACORE_COMMON

if SOC_SYNTACORE_SCR

choice SCR_PLATFORM
	prompt "SCR platform"
	default SCR9_L3
	help
	  CPU family and cluster type of the target. The platform selects the
	  feature booleans below, which the C code, the devicetree sources and
	  the Makefiles test; the platform itself is the only user-visible
	  selection.

config SCR9_L2
	bool "SCR9 L2"
	select SCR_CPU_SCR9
	select SCR_CLUSTER_L2

config SCR9_L3
	bool "SCR9 L3"
	select SCR_CPU_SCR9
	select SCR_CLUSTER_L3

config SCR7_L2
	bool "SCR7 L2"
	select SCR_CPU_SCR7
	select SCR_CLUSTER_L2

config SCR7_L3
	bool "SCR7 L3"
	select SCR_CPU_SCR7
	select SCR_CLUSTER_L3

endchoice

config SCR_OCRAM_BASE
	hex
	default 0x02000000 if SCR_CLUSTER_L3
	default 0xffffffffffff0000
	help
	  Base of the on-chip SRAM that runs all pre-RAM code and the hart
	  stacks. It has to match PLF_OCRAM_BASE of the SCR-HAL platform
	  selected by the CPU and cluster options; the HAL build asserts that.
	  No prompt: changing it alone produces an image that faults at the
	  reset vector.

config SCR_RESET_VECTOR
	hex "SCR reset vector address"
	default 0x02000200 if SCR_CLUSTER_L3
	default 0xffffffffffffff00
	help
	  Address the cluster resets to. L3 enters the bootblock at this
	  address inside OCRAM, so the bootblock load offset follows it; the
	  default is OCRAM base + 0x200. L2 has no reset entry of its own: the
	  bootblock carries a jump into the code there in the last 256 bytes
	  of the 64 KiB OCRAM, so the value must stay at OCRAM base + size -
	  0x100. The linker script asserts both relationships against
	  SCR_OCRAM_BASE and SCR_OCRAM_SIZE.

config SCR_HAL_PLATFORM
	string "SCR-HAL platform"
	default "scr9_l3" if SCR_CPU_SCR9 && SCR_CLUSTER_L3
	default "scr9_l2" if SCR_CPU_SCR9 && SCR_CLUSTER_L2
	default "scr7_l3" if SCR_CPU_SCR7 && SCR_CLUSTER_L3
	default "scr7_l2"
	help
	  SCR-HAL platform directory that describes the selected CPU and
	  cluster. Its PLF_* definitions drive the HAL objects, the MMIO
	  accessors and, through PLF_MEM_BASE, the linker layout, so the
	  value has to name a platform of the SCR-HAL tree; an unknown name
	  fails the build on its missing plf.h.

config RISCV_ARCH
	string "RISC-V ISA"
	default "rv64gc_sscofpmf_zfhmin_zihintpause_zba_zbb_zbc_zbs" if SCR_CPU_SCR9 && SCR_CLUSTER_L3
	default "rv64gc_zba_zbb_zbc_zbs"

endif
```
