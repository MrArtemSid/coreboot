## payloads/external/CrabEFI/Kconfig
```kconfig
## SPDX-License-Identifier: GPL-2.0-only

if PAYLOAD_CRABEFI

config PAYLOAD_FILE
	string "CrabEFI ELF binary"
	default "payloads/external/CrabEFI/CrabEFI/target/riscv64gc-unknown-none-elf/debug/crabefi" if CRABEFI_DEBUG && ARCH_RISCV_RV64
	default "payloads/external/CrabEFI/CrabEFI/target/riscv64gc-unknown-none-elf/release/crabefi" if ARCH_RISCV_RV64
	default "payloads/external/CrabEFI/CrabEFI/target/x86_64-unknown-none/debug/crabefi" if CRABEFI_DEBUG
	default "payloads/external/CrabEFI/CrabEFI/target/x86_64-unknown-none/release/crabefi"
	help
	  The path to the CrabEFI ELF binary.

config CRABEFI_PAYLOAD_BASE
	hex "CrabEFI link address"
	depends on ARCH_RISCV_RV64
	default 0x81000000
	help
	  CrabEFI is not relocatable on RISC-V and is linked at this
	  address. The default matches QEMU virt (DRAM + 16 MiB); boards
	  with a different DRAM base or coreboot layout override it.

choice
	prompt "CrabEFI version"
	default CRABEFI_MASTER

config CRABEFI_MASTER
	bool "master"
	help
	  Use the latest master branch of CrabEFI.

config CRABEFI_REVISION
	bool "git revision"
	help
	  Use a specific git revision of CrabEFI.

endchoice

config CRABEFI_REPOSITORY
	string "CrabEFI git repository URL"
	default "https://github.com/ArthurHeymans/CrabEFI"
	help
	  The git repository URL for CrabEFI.

config CRABEFI_TAG_OR_REV
	string "CrabEFI git tag or revision"
	default "origin/master" if CRABEFI_MASTER
	default "" if CRABEFI_REVISION
	help
	  The git tag, branch name, or commit SHA-1 to use.
	  For branch names, prefix with "origin/" (e.g., "origin/master").

choice
	prompt "CrabEFI build type"
	default CRABEFI_RELEASE

config CRABEFI_DEBUG
	bool "Debug"
	help
	  Build CrabEFI with debug symbols and without optimizations.

config CRABEFI_RELEASE
	bool "Release"
	help
	  Build CrabEFI with optimizations.

endchoice

config CRABEFI_UI
	bool "Enable CrabEFI graphical UI"
	default y
	help
	  Enable CrabEFI's graphical UI, including mouse support and the
	  setup utility.

endif # PAYLOAD_CRABEFI
```

## payloads/external/U-Boot-Syntacore/Kconfig.name
```kconfig
## SPDX-License-Identifier: GPL-2.0-only

config PAYLOAD_UBOOT_SYNTACORE
	bool "U-Boot (Syntacore)"
	depends on SOC_SYNTACORE_COMMON
	help
	  Select this option to build the Syntacore U-Boot (3rdparty/u-boot
	  submodule, branch sc/2026.04) as the S-mode payload coreboot hands
	  over to OpenSBI. The Syntacore defconfig matching the platform is
	  used, with U-Boot linked at the entry address coreboot passes to
	  OpenSBI through the fw_dynamic info.

	  See Documentation/mainboard/syntacore/sc-qemu.md for the build and
	  run flows.
```

## payloads/external/U-Boot/Kconfig
```kconfig
## SPDX-License-Identifier: GPL-2.0-only

if PAYLOAD_UBOOT

config PAYLOAD_SPECIFIC_OPTIONS
	def_bool y
	select PAYLOAD_IS_FLAT_BINARY if ARCH_X86
	select WANT_LINEAR_FRAMEBUFFER if ARCH_X86

config UBOOT_STABLE
	bool "v2025.07"
	help
	  Stable U-Boot version

config UBOOT_BRANCH_OR_TAG
	string "branch/tag to use for u-boot payload"
	default "v2025.07" if UBOOT_STABLE
	default "master"

config UBOOT_REPO_URL
	string "URL to uboot repository"
	default "http://github.com/u-boot/u-boot/"

config UBOOT_DEFCONFIG
	string "U-Boot defconfig"
	default "coreboot_defconfig" if ARCH_X86
	default "qemu-riscv64_smode_defconfig" if ARCH_RISCV_RV64
	default "qemu-riscv32_smode_defconfig" if ARCH_RISCV_RV32
	help
	  U-Boot defconfig used when no PAYLOAD_CONFIGFILE is given.
	  Platforms with their own U-Boot board set this.

config UBOOT_TEXT_BASE
	hex "U-Boot link address"
	depends on ARCH_RISCV
	default 0x81000000 if BOARD_EMULATION_QEMU_RISCV
	help
	  Overrides CONFIG_TEXT_BASE of the U-Boot build. The RISC-V
	  defconfigs link U-Boot right above the OpenSBI default region,
	  which is where coreboot keeps its own stages, so the ELF payload
	  has to be moved to a free DRAM address.

config UBOOT_CROSS_COMPILE
	string "U-Boot cross compiler prefix"
	depends on ARCH_RISCV
	default ""
	help
	  Toolchain prefix for the U-Boot build, e.g. "riscv64-linux-gnu-".
	  U-Boot links its EFI selftest applications as shared objects,
	  which bare-metal ELF toolchains cannot do. When empty, the
	  coreboot RISC-V toolchain is used.

config PAYLOAD_CONFIGFILE
	string "U-Boot config file"
	default ""
	help
	  This option allows a platform to set Kconfig options for a basic
	  U-Boot payload.  In general, if the option is used, the default
	  would be "$(top)/src/mainboard/$(MAINBOARDDIR)/config_uboot"
	  for a config stored in the coreboot mainboard directory, or
	  "$(project_dir)/configs/coreboot-x86_defconfig" to use a config
	  from the U-Boot config directory

config PAYLOAD_FILE
	default "payloads/external/U-Boot/build/u-boot.bin" if ARCH_X86
	default "payloads/external/U-Boot/build/u-boot"

config PAYLOAD_OPTIONS
	default "-l 0x1110000 -e 0x1110000" if ARCH_X86

endif
```

## src/cpu/intel/grantley/Kconfig
```kconfig
## SPDX-License-Identifier: GPL-2.0-only

config CPU_INTEL_GRANTLEY
	bool
	select ARCH_X86
	select SSE2
	select UDELAY_TSC
	select TSC_MONOTONIC_TIMER
	select TSC_SYNC_MFENCE
	select CPU_INTEL_COMMON
	select CPU_INTEL_COMMON_TIMEBASE
	select SUPPORT_CPU_UCODE_IN_CBFS
	select MICROCODE_UPDATE_PRE_RAM
	# Port I/O requires SAD routing, installed by the CPU CAR entry.
	select NO_EARLY_BOOTBLOCK_POSTCODES
	select CPU_INTEL_FIRMWARE_INTERFACE_TABLE

if CPU_INTEL_GRANTLEY

config GRANTLEY_KBC_EARLY_BEACON
	bool
	help
	  Blink the PS/2 keyboard LEDs from the pre-CAR bootblock assembly,
	  before SAD verification, microcode and CAR.  For boards whose only
	  early output channel is the keyboard (no POST display, COM A not
	  enabled by the vendor firmware): the beacon enables the CNF1/KBC
	  LPC decodes, brings the Nuvoton KBC up on LDN5 at 0x2e and flashes
	  all three LEDs three times.  Its absence localizes a dead board to
	  the reset-vector/SPI-fetch/32-bit-entry span; the later per-stage
	  beacons then cover everything up to the payload.

config SMM_TSEG_SIZE
	hex
	default 0x800000

config IED_REGION_SIZE
	hex
	default 0x400000

config SMM_RESERVED_SIZE
	hex
	default 0x100000

config MAX_CPUS
	int
	default 44
	help
	  Supports up to 22-core / 44-thread Xeon E5 v3 and v4 processors.

endif
```

## src/cpu/intel/haswell_ep/Kconfig
```kconfig
## SPDX-License-Identifier: GPL-2.0-only

config CPU_INTEL_HASWELL_EP
	bool
	select ARCH_X86
	select SSE2
	select UDELAY_TSC
	select TSC_MONOTONIC_TIMER
	select TSC_SYNC_MFENCE
	select CPU_INTEL_COMMON
	select CPU_INTEL_COMMON_TIMEBASE
	select SUPPORT_CPU_UCODE_IN_CBFS

if CPU_INTEL_HASWELL_EP

config SMM_TSEG_SIZE
	hex
	default 0x800000

config IED_REGION_SIZE
	hex
	default 0x400000

config SMM_RESERVED_SIZE
	hex
	default 0x100000

config MAX_CPUS
	int
	default 1
	help
	  Only the BSP is used by the diagnostic bring-up path. AP startup,
	  SMM and runtime CPU initialization are not implemented yet.

endif
```

## src/mainboard/angxun/Kconfig
```kconfig
if VENDOR_ANGXUN

choice
	prompt "Mainboard model"

source "src/mainboard/angxun/*/Kconfig.name"

endchoice

source "src/mainboard/angxun/*/Kconfig"

config MAINBOARD_VENDOR
	default "Angxun"

endif # VENDOR_ANGXUN
```

## src/mainboard/angxun/x99-xd4/Kconfig
```kconfig
## SPDX-License-Identifier: GPL-2.0-only

if BOARD_ANGXUN_X99_XD4

config BOARD_SPECIFIC_OPTIONS
	def_bool y
	select NORTHBRIDGE_INTEL_GRANTLEY
	select SOUTHBRIDGE_INTEL_LYNXPOINT
	select SUPERIO_NUVOTON_COMMON_PRE_RAM
	select SUPERIO_NUVOTON_COMMON_COM_A
	select SUPERIO_NUVOTON_NCT5539D
	select SERIRQ_CONTINUOUS_MODE
	select BOARD_ROMSIZE_KB_16384
	select AZALIA_USE_LEGACY_VERB_TABLE
	select HAVE_ACPI_TABLES

config MAINBOARD_DIR
	default "angxun/x99-xd4"

config MAINBOARD_PART_NUMBER
	default "X99-XD4"

config BOOTBLOCK_CONSOLE
	default y

config GRANTLEY_INTELSETUP_SERIAL_LEVEL_OFFSET
	default 0x2d6

endif # BOARD_ANGXUN_X99_XD4
```

## src/mainboard/angxun/x99-xd4/Kconfig.name
```kconfig
## SPDX-License-Identifier: GPL-2.0-only

config BOARD_ANGXUN_X99_XD4
	bool "X99-XD4"
```

## src/mainboard/asus/z10pa-d8/Kconfig.name
```kconfig
## SPDX-License-Identifier: GPL-2.0-only

config BOARD_ASUS_Z10PA_D8
	bool "Z10PA-D8"
```

## src/mainboard/envinda/Kconfig
```kconfig
## SPDX-License-Identifier: GPL-2.0-only

if VENDOR_ENVINDA

choice
	prompt "Mainboard model"

source "src/mainboard/envinda/*/Kconfig.name"

endchoice

source "src/mainboard/envinda/*/Kconfig"

config MAINBOARD_VENDOR
	default "Envinda"

endif # VENDOR_ENVINDA
```

## src/mainboard/envinda/x99d4m4/Kconfig
```kconfig
## SPDX-License-Identifier: GPL-2.0-only

if BOARD_ENVINDA_X99D4M4

config BOARD_SPECIFIC_OPTIONS
	def_bool y
	select NORTHBRIDGE_INTEL_GRANTLEY
	select SOUTHBRIDGE_INTEL_LYNXPOINT
	select SUPERIO_NUVOTON_COMMON_PRE_RAM
	select SUPERIO_NUVOTON_NCT5539D
	select BOARD_ROMSIZE_KB_16384
	select AZALIA_USE_LEGACY_VERB_TABLE
	select HAVE_ACPI_TABLES
	select HAVE_ACPI_RESUME

config MAINBOARD_DIR
	default "envinda/x99d4m4"

config MAINBOARD_PART_NUMBER
	default "X99D4M4"

config BOOTBLOCK_CONSOLE
	default y

endif
```

## src/mainboard/envinda/x99d4m4/Kconfig.name
```kconfig
## SPDX-License-Identifier: GPL-2.0-only

config BOARD_ENVINDA_X99D4M4
	bool "X99D4M4"
```

## src/mainboard/huananzhi/Kconfig
```kconfig
## SPDX-License-Identifier: GPL-2.0-only

if VENDOR_HUANANZHI

choice
	prompt "Mainboard model"

source "src/mainboard/huananzhi/*/Kconfig.name"

endchoice

source "src/mainboard/huananzhi/*/Kconfig"

config MAINBOARD_VENDOR
	default "Huananzhi"

endif # VENDOR_HUANANZHI
```

## src/mainboard/huananzhi/Kconfig.name
```kconfig
## SPDX-License-Identifier: GPL-2.0-only

config VENDOR_HUANANZHI
	bool "Huananzhi"
```

## src/mainboard/huananzhi/x99-qd4/Kconfig
```kconfig
## SPDX-License-Identifier: GPL-2.0-only

if BOARD_HUANANZHI_X99_QD4

config BOARD_SPECIFIC_OPTIONS
	def_bool y
	select AZALIA_USE_LEGACY_VERB_TABLE
	select BOARD_ROMSIZE_KB_16384
	select HAVE_ACPI_RESUME
	select HAVE_ACPI_TABLES
	select MEMORY_MAPPED_TPM
	select NORTHBRIDGE_INTEL_GRANTLEY
	select SERIRQ_CONTINUOUS_MODE
	select SOUTHBRIDGE_INTEL_LYNXPOINT
	select SUPERIO_NUVOTON_COMMON_PRE_RAM
	select SUPERIO_NUVOTON_NCT5539D

config MAINBOARD_DIR
	string
	default "huananzhi/x99-qd4"

config MAINBOARD_PART_NUMBER
	string
	default "X99-QD4"

# A single-socket desktop board: the HEDT platform type.
config GRANTLEY_PLATFORM_TYPE
	default 0x13

config USBDEBUG_HCD_INDEX # FIXME: check this
	int
	default 2
endif
```

## src/mainboard/huananzhi/x99-qd4/Kconfig.name
```kconfig
## SPDX-License-Identifier: GPL-2.0-only

config BOARD_HUANANZHI_X99_QD4
	bool "X99-QD4"
```

## src/mainboard/huananzhi/x99-series/Kconfig
```kconfig
## SPDX-License-Identifier: GPL-2.0-only

if BOARD_HUANANZHI_X99_QD4

config BOARD_SPECIFIC_OPTIONS
	def_bool y
	select NORTHBRIDGE_INTEL_GRANTLEY
	select SOUTHBRIDGE_INTEL_LYNXPOINT
	select SUPERIO_NUVOTON_COMMON_PRE_RAM
	select SUPERIO_NUVOTON_NCT5539D
	select BOARD_ROMSIZE_KB_16384
	select AZALIA_USE_LEGACY_VERB_TABLE
	select HAVE_ACPI_TABLES

config MAINBOARD_DIR
	default "huananzhi/x99-series"

config VARIANT_DIR
	default "qd4"

config IFD_BIN_PATH
	string
	depends on HAVE_IFD_BIN
	default "3rdparty/blobs/mainboard/huananzhi/x99-series/descriptor.bin"

config ME_BIN_PATH
	string
	depends on HAVE_ME_BIN && !STITCH_ME_BIN
	default "3rdparty/blobs/mainboard/huananzhi/x99-series/me.bin"

config INTEL_UNCORE_BIN_FILE
	string
	depends on HAVE_INTEL_UNCORE_BIN
	default "3rdparty/blobs/mainboard/huananzhi/x99-series/uncore.bin"

config OVERRIDE_DEVICETREE
	default "variants/\$(CONFIG_VARIANT_DIR)/overridetree.cb"

config MAINBOARD_PART_NUMBER
	default "X99-QD4"

config BOOTBLOCK_CONSOLE
	default y

endif
```

## src/mainboard/huananzhi/x99_ep/Kconfig
```kconfig
## SPDX-License-Identifier: GPL-2.0-only

if BOARD_HUANANZHI_X99_QD4 || BOARD_HUANANZHI_X99_BD4

config BOARD_SPECIFIC_OPTIONS
	def_bool y
	select NORTHBRIDGE_INTEL_HASWELL_EP
	select SOUTHBRIDGE_INTEL_LYNXPOINT
	select SUPERIO_NUVOTON_COMMON_PRE_RAM
	select BOARD_ROMSIZE_KB_16384

config MAINBOARD_DIR
	default "huananzhi/x99_ep"

config VARIANT_DIR
	default "QD4" if BOARD_HUANANZHI_X99_QD4
	default "BD4" if BOARD_HUANANZHI_X99_BD4

config OVERRIDE_DEVICETREE
	default "variants/\$(CONFIG_VARIANT_DIR)/overridetree.cb"

config MAINBOARD_PART_NUMBER
	default "X99-QD4" if BOARD_HUANANZHI_X99_QD4
	default "X99-BD4" if BOARD_HUANANZHI_X99_BD4

config BOOTBLOCK_CONSOLE
	default y

endif
```

## src/mainboard/huananzhi/x99_ep/Kconfig.name
```kconfig
## SPDX-License-Identifier: GPL-2.0-only

config BOARD_HUANANZHI_X99_QD4
	bool "X99-QD4 (diagnostic only, no DRAM init)"

config BOARD_HUANANZHI_X99_BD4
	bool "X99-BD4 (diagnostic only, no DRAM init)"
```

## src/mainboard/machenike/Kconfig
```kconfig
## SPDX-License-Identifier: GPL-2.0-only

if VENDOR_MACHENIKE

choice
	prompt "Mainboard model"

source "src/mainboard/machenike/*/Kconfig.name"

endchoice

source "src/mainboard/machenike/*/Kconfig"

config MAINBOARD_VENDOR
	default "Machenike"

endif # VENDOR_MACHENIKE
```

## src/mainboard/machenike/s15c/Kconfig
```kconfig
## SPDX-License-Identifier: GPL-2.0-only

config BOARD_MACHENIKE_S15C
	bool "S15C (V155PNPQ-HMx)"
	select BOARD_MACHENIKE_S15C_COMMON

if BOARD_MACHENIKE_S15C

config BOARD_MACHENIKE_S15C_COMMON
	def_bool n
	select BOARD_ROMSIZE_KB_32768
	select SOC_INTEL_ALDERLAKE_PCH_P
	select DRIVERS_I2C_HID
	select DRIVERS_WIFI_GENERIC
	select EC_ACPI
	select HAVE_ACPI_RESUME
	select HAVE_ACPI_TABLES
	select HAVE_CMOS_DEFAULT
	select HAVE_OPTION_TABLE
	select INTEL_GMA_HAVE_VBT
	select INTEL_LPSS_UART_FOR_CONSOLE
	select MAINBOARD_USES_IFD_GBE_REGION
	select SPD_READ_BY_WORD
	select SYSTEM_TYPE_LAPTOP

config MAINBOARD_DIR
	default "machenike/s15c"

config MAINBOARD_PART_NUMBER
	default "S15C"

endif # BOARD_MACHENIKE_S15C
```

## src/mainboard/machenike/s15c/Kconfig.name
```kconfig
## SPDX-License-Identifier: GPL-2.0-only

config BOARD_MACHENIKE_S15C
	bool "S15C (V155PNPQ-HMx)"
```
